/********************************** (C) COPYRIGHT *********************************
* File Name          : HTTPS.C
* Author             : WCH
* Version            : V1.1
* Date               : 2014/8/1
* Description        : web接口函数
*             
**********************************************************************************/
#include <stdio.h>
#include <string.h>
#include <stdlib.h>  
#include "..\SRC\SYSFREQ.H"
#include "https.h"
#include "ch395.h" 
#include "..\..\PUB\ch395cmd.h" 

/*临时变量及外部变量变量声明*/
 UINT8  ip[4],i,lastip[4],ADC[3];
 UINT16 port,lastport,len;
 char tempURI[MAX_URI_SIZE]; 
 extern char  homepage_default[],test[];
 extern UINT8 HtmlBuffer[2716];
 extern st_http_request *http_request;  
 char   *ptr1,*name,*ptemp;

/*********************WEB响应报文***************************************/
 UINT8 httpweb[200] ; 
/********************HTML文本信息***************************************/
 UINT8 HtmlBuffer[2716] = {
  0x3C, 0x21, 0x44, 0x4F, 0x43, 0x54, 0x59, 0x50, 0x45, 0x20, 0x68, 0x74, 0x6D, 0x6C, 0x3E, 0x0D, 
  0x0A, 0x3C, 0x68, 0x74, 0x6D, 0x6C, 0x3E, 0x0D, 0x0A, 0x3C, 0x68, 0x65, 0x61, 0x64, 0x3E, 0x0D, 
  0x0A, 0x3C, 0x62, 0x6F, 0x64, 0x79, 0x3E, 0x0D, 0x0A, 0x0D, 0x0A, 0x3C, 0x2F, 0x68, 0x65, 0x61, 
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  0x64, 0x79, 0x3E, 0x0D, 0x0A, 0x3C, 0x2F, 0x68, 0x74, 0x6D, 0x6C, 0x3E
  };

/*********************************************************************************
* Function Name  : MakeHttpResponse
* Description    : 生成响应报文
* Input          : 缓冲区指针，uri类型
* Output         : None
* Return         : None
*********************************************************************************/
void MakeHttpResponse(unsigned char * buf,char type)
{
  char * head=0;
  char tmp[10];
  UINT16 len;      
  if   (type == PTYPE_HTML)        head = RES_HTMLHEAD_OK;
  else if (type == PTYPE_GIF)      head = RES_GIFHEAD_OK;
  else if (type == PTYPE_TEXT)     head = RES_TEXTHEAD_OK;
  else if (type == PTYPE_JPEG)     head = RES_JPEGHEAD_OK;
  else if (type == PTYPE_FLASH)    head = RES_FLASHHEAD_OK;
  else if (type == PTYPE_MPEG)     head = RES_MPEGHEAD_OK;
  else if (type == PTYPE_PDF)      head = RES_PDFHEAD_OK;
  else if (type == PTYPE_CGI)      head = RETURN_CGI_PAGE;
  len = sizeof(HtmlBuffer);                      
  sprintf(tmp,"%ld", len);  
  strcpy((char*)buf, head);
  strcat((char*)buf, tmp);
  strcat((char*)buf, "\r\n\r\n");
}

 /*********************************************************************************
* Function Name  : ParseUriType
* Description    : 解析URI类型
* Input          : 缓冲区指针，类型返回指针
* Output         : None
* Return         : None
*********************************************************************************/
void ParseUriType(UINT8 * type,char * buf ) 
{
  if    (strstr(buf, ".htm"))                             *type = PTYPE_HTML;
  else if (strstr(buf, ".gif"))                           *type = PTYPE_GIF;
  else if (strstr(buf, ".text") || strstr(buf,".txt"))    *type = PTYPE_TEXT;
  else if (strstr(buf, ".jpeg") || strstr(buf,".jpg"))    *type = PTYPE_JPEG;
  else if (strstr(buf, ".swf"))                           *type = PTYPE_FLASH;
  else if (strstr(buf, ".mpeg") || strstr(buf,".mpg"))    *type = PTYPE_MPEG;
  else if (strstr(buf, ".pdf"))                           *type = PTYPE_PDF;
  else if (strstr(buf, ".cgi") || strstr(buf,".CGI"))     *type = PTYPE_CGI;
  else if (strstr(buf, ".js") || strstr(buf,".JS"))       *type = PTYPE_TEXT;  
  else if (strstr(buf, ".xml") || strstr(buf,".XML"))     *type = PTYPE_HTML;    
  else                                                    *type = PTYPE_ERR;
}

 /*********************************************************************************
* Function Name  : ParseHttpRequest
* Description    : 解析HTTP请求
* Input          : URI请求指针，缓冲区指针
* Output         : None
* Return         : None
*********************************************************************************/
void ParseHttpRequest(st_http_request * request,UINT8 * buf)
{
  char * nexttok;
  nexttok = strtok((char*)buf," ");
  if(!nexttok)
  {
    request->METHOD = METHOD_ERR;
    return;
  }
  if   (!strcmp(nexttok, "GET") || !strcmp(nexttok,"get"))
  {
    request->METHOD = METHOD_GET;
    nexttok = strtok(NULL," ");      
  }
  else if (!strcmp(nexttok, "HEAD") || !strcmp(nexttok,"head"))  
  {
    request->METHOD = METHOD_HEAD;
    nexttok = strtok(NULL," ");
    printf("METHOD = HEAD!\n");    
          
  }
  else if (!strcmp(nexttok, "POST") || !strcmp(nexttok,"post"))
  {
    nexttok = strtok(NULL,"\0");
    request->METHOD = METHOD_POST;
    printf("METHOD = POST!\n");    
        
  }
  else
  {
    request->METHOD = METHOD_ERR;        
    }  
  
  if(!nexttok)
  {
    request->METHOD = METHOD_ERR;      
    return;
  }
     strcpy((char*)request->URI,nexttok);
}

/*********************************************************************************
* Function Name  : DataLocate
* Description    : 寻找指定字符位置
* Input          : 缓冲区指针，寻找字符
* Output         : None
* Return         : None
*********************************************************************************/
PINT8 DataLocate(PINT8 buf,char * name)
{
   PINT8 p;
   p = strstr((char *)buf,name);
   if (p==NULL) return NULL;
   p += strlen(name); 
   return p;
}

/*********************************************************************************
* Function Name  : GetUriName
* Description    : 获取URI
* Input          : URI
* Output         : None
* Return         : None
*********************************************************************************/
unsigned char* GetUriName(char* uri)
{
  UINT8* uri_name;
  if(!uri) return 0;
  memset (tempURI, 0, MAX_URI_SIZE);  
  strcpy((char*)tempURI,uri);
  uri_name = (UINT8*)strtok(tempURI," ?");
  if(strcmp((char *)uri_name,"/")) uri_name++;
  return uri_name;
}

/*********************************************************************************
* Function Name  : LedControl
* Description    : led控制程序
* Input          : 缓冲区指针
* Output         : None
* Return         : None
*********************************************************************************/
void LedControl(UINT8 *buf)
{   
     ptemp = strstr((char *)buf,"LEDCONTROL");                                                   /*查找接收缓冲区(浏览器请求信息)，确认是否有LED控制请求*/
     if(ptemp !=NULL)
     {
       ptemp = DataLocate((char *)buf,"led1=");
     if(ptemp!= NULL)
      {              
        
         if(*ptemp =='1')                                                                         /*查看led1的值。为1则灯亮，为2则灭，此值与HTML网页中设置有关*/
         {     
          printf("LED1-0N\n");
          R32_PA_CLR |= TACK;
          ptemp = DataLocate((char *)HtmlBuffer,"LED1 状态：");
          *ptemp++ = 0xc1;
          *ptemp = 0xc1;                                                                           /*******(汉字)亮：0xc1,0xc1****************/
         }
         else
         {
          printf("LED1-0FF\n");
          R32_PA_OUT |= TACK;
          ptemp = DataLocate((char *)HtmlBuffer,"LED1 状态：");
          *ptemp++ = 0xc3;                                                                          /*******(汉字)灭：0xc3,oxf0****************/
          *ptemp = 0xf0;
          }

       }
      ptemp = strstr((char *)buf,"led2=");                                                          /*查看led2的值。为3则灯亮，为4则灭，此值与HTML网页中设置有关*/
      if(ptemp!=NULL )
     {
        ptemp+=strlen("led2 ");
        if(*ptemp =='3')
         {  
           printf("LED2-0N\n");
           R32_PA_CLR |= TDI;
           ptemp = DataLocate((char *)HtmlBuffer,"LED2 状态：");
           *ptemp++ = 0xc1;
           *ptemp = 0xc1;
         }
        else
         {
           printf("LED2-0FF\n");
           R32_PA_OUT |= TDI;
           ptemp = DataLocate((char *)HtmlBuffer,"LED2 状态：");
           *ptemp++ = 0xc3;
           *ptemp = 0xf0;
         }
        }
     }
}

/*********************************************************************************
* Function Name  : IpSeting
* Description    : IP设置
* Input          : 缓冲区指针
* Output         : None
* Return         : None
*********************************************************************************/
void IpSeting(UINT8 *buf1,UINT8 *buf2)
{
   char *p=0;
   UINT8 i;
   UINT8 tbuf[128];
   strcpy((char *)tbuf,(char *)buf1);  
   p = DataLocate((char *)tbuf,"IP");                                                                 /*指针右移到ip*/                            
   p++;
   for(i=0;i<3;i++)
   {
   p = strtok((char *)p,".");
   *buf2++ = atoi((char *)p) ;
   p=NULL;
   }
   p=strtok(p,"&");
   *buf2++ = atoi((char *)p) ;                        
}

/*********************************************************************************
* Function Name  : IpRefrsh
* Description    : 更新IP信息到web页面
* Input          : 缓冲区指针
* Output         : None
* Return         : None
*********************************************************************************/
void IpRefrsh(UINT8 *buf,UINT8 *buf2)
{
   UINT8 s[20],i;
   char *p;
   sprintf((char *)s ,"%d.%d.%d.%d ", (UINT16)buf2[0],(UINT16)buf2[1],(UINT16)buf2[2],(UINT16)buf2[3]);/*将新的IP格式化到set缓冲区*/
   p = DataLocate((char *)buf,"IP type=text value"); 
   p++;
   for(i=0;i<strlen((char *)s);i++)                                                                    /*将格式化到set缓冲区的IP内容更新到web页面信息中去*/
   {
    *p++=s[i];
   }
}

/*********************************************************************************
* Function Name  : PortSeting
* Description    : 端口设置
* Input          : 缓冲区指针
* Output         : None
* Return         : None
*********************************************************************************/
UINT16  PortSeting (UINT8 *buf)
{
   char *p;
   UINT8  s[10],i;
   UINT16 port = 0;
   p = DataLocate((char *)buf,"PORT");                                                                  /*从请求信息中提取Port信息*/
   if(p !=NULL)
   {
   p++;
   memset(s,0,10);
   i = 0;
   while(*p !=0)
   {
    s[i++]= *p++;
   }
   port = atoi((char *)s);
   }
   return port;  
}

/*********************************************************************************
* Function Name  : PortRefresh
* Description    : 更新Port信息到web页面
* Input          : 缓冲区指针
* Output         : None
* Return         : None
*********************************************************************************/
void PortRefresh (UINT8 *buf,UINT16 port)
{   
  UINT8 s[10],i;
  char *p;
  sprintf((char *)s ,"%d",(UINT16)port);
  p = DataLocate((char *)buf,"PORT type=text value="); 
  for(i=0;i<strlen((char *)s);i++)
  {
    *p++=s[i];
  }
  for(i=0;i<3;i++)
  {
    *p++=0x20;
  }
}

/*********************************************************************************
* Function Name  : TempratureRefresh
* Description    : 更新Temprature信息到web页面
* Input          : 缓冲区指针
* Output         : None
* Return         : None
*********************************************************************************/
void TempratureRefresh (UINT8 *buf,UINT8 temp)
{
   UINT8 s[3],i;
   char *p;
   sprintf((char *)s,"%d",temp );                                                                      /*设置温度信息，并刷新到WEB页面*/
   p= DataLocate((char *)buf,"温度");
   p++;
   p++;
   for(i=0;i<2;i++)
   {
    *p++=s[i];
   }
}

/**********************************************************************************
* Function Name  : CurrentRefresh
* Description    : 更新Current信息到web页面
* Input          : 缓冲区指针
* Output         : None
* Return         : None
*********************************************************************************/
void CurrentRefresh (UINT8 *buf,UINT8 curr)
{
   UINT8 s[3],i;
   char *p;
   sprintf((char *)s,"%d",curr );                                                                      /*设置电流信息，并刷新到WEB页面*/
   p= DataLocate((char *)buf,"电流");
   p++;
   p++;
   for(i=0;i<2;i++)
   {
    *p++=s[i];
   }
}

/**********************************************************************************
* Function Name  : VoltageRefresh
* Description    : 更新Voltage信息到web页面
* Input          : 缓冲区指针
* Output         : None
* Return         : None
*********************************************************************************/
void VoltageRefresh (UINT8 *buf,UINT8 volt)
{
   UINT8 s[3],i;
   char *p;
   sprintf((char *)s,"%d",volt );                                                                         /*设置电压信息，并刷新到WEB页面*/
   p= DataLocate((char *)buf,"电压");
   p++;
   p++;
   for(i=0;i<2;i++)
   {
    *p++=s[i];
   }
}

/**********************************************************************************
* Function Name  : ADCData
* Description    : 使用随机数模拟ADC数据
* Input          : 缓冲区指针
* Output         : None
* Return         : None
*********************************************************************************/
void ADCData(UINT8 *buf)                                                                                   /*随机数生成，模拟ADC结果*/
{
  *buf++ = 10+(UINT16)rand()%30;
  *buf++ = 10+(UINT16)rand()%50;
  *buf = 10+(UINT16)rand()%10;
}

/**********************************************************************************
* Function Name  : WebServer
* Description    : web服务主程序
* Input          : WebServer
* Output         : None
* Return         : None
*********************************************************************************/
void WebServer(void)
{
     if(flag & RECVDATA )
     {
     flag  &= ~RECVDATA;
     ParseHttpRequest(http_request,RecvBuffer);    
     switch (http_request->METHOD)  
       {
        case METHOD_ERR :  
             break;
        case METHOD_HEAD:
        case METHOD_POST:
        case METHOD_GET:
          name = (char*)GetUriName((char *)http_request->URI);
          if (!strcmp(name, "/")) {http_request->TYPE = PTYPE_HTML;}
          else { ParseUriType(&http_request->TYPE, name);  }
          if(http_request->TYPE == PTYPE_CGI)
          {
           LedControl(http_request->URI);                                                                    /*LED控制部分*/
           ptr1 =  strstr((char *)(http_request->URI),"CH395SETING") ;                                       /*查找接收缓冲区(浏览器请求信息)，确认是否有CH395设置请求*/
           if(ptr1 !=NULL)
           {
             ptr1 = strstr((char *)(http_request->URI),"IP");                                                /*从浏览器请求信息中提取 IP 信息*/
           if (ptr1 !=NULL)
           {
             printf("******IP计算****************************************\n");
             IpSeting((http_request->URI),ip);
             printf("New IP address = %d.%d.%d.%d\n",(UINT16)ip[0],(UINT16)ip[1],(UINT16)ip[2],(UINT16)ip[3]);        
             i = memcmp(lastip,ip,4);                                                                         /*与上一次提取的IP进行对比，查看是否改变，如果改变则顺序执行下面的IP设置部分，否则跳过*/
             if(i){                                                                                           /*IP改变*/
                  flag |=IPCHANGE;                                                                            /*IP改变，flag标志位0置1*/
                  printf("ip change\n");
                  memcpy (CH395IPAddr,ip,4);                                                                  /*更新CH395的IP信息*/
                  memcpy (lastip,ip,4);                                                                       /*新的IP值赋给前一次，方便下次比较*/
                  IpRefrsh(HtmlBuffer,ip);
                  }
            }            
              
            ptr1 = strstr((char *)(http_request->URI),"PORT");                                                /*从请求信息中提取Port信息*/   
            if (ptr1 !=NULL)
            {
             printf("******PORT计算****************************************\n");
             port = PortSeting(http_request->URI);
             printf("New Port = %2d\n",(UINT16)port);
             if(port != lastport)                                                                             /*与上一次提取的Port进行对比，查看是否改变，如果改变则顺序执行下面的Port设置部分，否则跳过*/
              {
              flag |=PORTCHANGE;                                                                              /*IP改变，flag标志位1置1*/
              Socket0SourPort = port;
              lastport = port;
              printf("port change\n");
              PortRefresh(HtmlBuffer,port);
              }
             }
             }

             ptr1 = strstr((char *)(http_request->URI),"monitor");                                           /*查找接收缓冲区(浏览器请求信息)，确认是否有查看监控信息请求*/
             if(ptr1 !=NULL)
              {
              ADCData(ADC);       
              TempratureRefresh(HtmlBuffer,ADC[0]);
              CurrentRefresh(HtmlBuffer,ADC[1]);
              VoltageRefresh(HtmlBuffer,ADC[2]);
              }
            }
           MakeHttpResponse(httpweb,http_request->TYPE);
           CH395SendData(0,httpweb,strlen((char*)httpweb));                                                   /*发送响应报文*/  
           mDelaymS(20);
           i = CH395GetSocketInt(0);                                                                          /*将更新的数据送给浏览器*/
           len = sizeof(HtmlBuffer);
           SockInf.RemLen = len;                                                                              /* 保存长度 */
           if(len > 2048)len = 2048;                                                                          /* 发送缓冲区最大为2048 */
           CH395SendData(0,HtmlBuffer,len);
           SockInf.SendLen = len;                                                                             /* 保存发送的长度 */                                         
           SockInf.pSend = HtmlBuffer;                                                                        /* 发送换取区指针 */
       }     
       }

}
